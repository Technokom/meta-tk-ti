## conf/layer.conf
```bitbake
# We have a conf and classes directory, append to BBPATH
BBPATH .= ":${LAYERDIR}"

# We have a recipes directory, add to BBFILES
BBFILES += "${LAYERDIR}/recipes*/*/*.bb ${LAYERDIR}/recipes*/*/*.bbappend"

BBFILE_COLLECTIONS += "meta-tk-ti"
BBFILE_PATTERN_meta-tk-ti := "^${LAYERDIR}/"
BBFILE_PRIORITY_meta-tk-ti = "6"

SIGGEN_EXCLUDE_SAFE_RECIPE_DEPS += " \
    weston-init->weston \
    weston-init->kbd \
"

SIGGEN_EXCLUDERECIPES_ABISAFE += " \
    udev \
    eudev \
    weston-conf \
    qtbase-conf \
    cryptodev-module \
"
```

## conf/machine/include/tk-ti43x.inc
```bitbake
require conf/machine/include/ti-soc.inc
SOC_FAMILY_append = ":ti43x"

DEFAULTTUNE ?= "armv7athf-neon"
require conf/machine/include/tune-cortexa9.inc

PREFERRED_PROVIDER_virtual/xserver = "xserver-xorg"

# For built-in LCD, add xf86-input-tslib
XSERVER = "xserver-xorg \
           xf86-input-evdev \
           xf86-input-mouse \
           xf86-video-fbdev \
           xf86-input-keyboard"

# Default to external video, change to smallscreen for built-in LCD
MACHINE_GUI_CLASS = "bigscreen"

# Increase this everytime you change something in the kernel
MACHINE_KERNEL_PR = "r3"

# Default providers, may need to override for specific machines
PREFERRED_PROVIDER_virtual/kernel_skit-am437x = "linux-ti-technokom"
PREFERRED_PROVIDER_virtual/bootloader = "u-boot-tk-staging"
PREFERRED_PROVIDER_u-boot = "u-boot-tk-staging"

KERNEL_IMAGETYPE = "zImage"

KERNEL_DEVICETREE = "tk-am437x-sk.dtb"


UBOOT_MACHINE = "tk-som-am43xx_config"

UBOOT_ARCH = "arm"
UBOOT_MACHINE = "tk-som-am43xx_config"

UBOOT_ENTRYPOINT = "0x80008000"
UBOOT_LOADADDRESS = "0x80008000"

EXTRA_IMAGEDEPENDS += "u-boot"

# List common SoC features, may need to add touchscreen for specific machines
MACHINE_FEATURES = "kernel26 apm usbgadget usbhost vfat ext2 screen alsa ethernet sgx"
```

## conf/machine/skit-am437x.conf
```bitbake
#@TYPE: Machine
#@NAME: skit-am437x
#@DESCRIPTION: machine configuration for Technokom starter kit based ti am437x

require conf/machine/include/tk-ti43x.inc

MACHINE_EXTRA_RRECOMMENDS = " kernel-modules"

# Use built-in LCD by default
# XSERVER += "xf86-input-tslib"
MACHINE_GUI_CLASS = "smallscreen"
MACHINE_FEATURES += "touchscreen"

IMAGE_FSTYPES += "tar.xz ext4.gz ext4"


SERIAL_CONSOLE = "115200 ttyS0"

BUILD_VERSION = "1.0.0"
```
